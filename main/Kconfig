## main/Kconfig
```kconfig
menu "Custom Pin Configuration"

    config PN532_SCL_PIN
        int "PN532 I2C SCL Pin"
        range 0 21
        help
            GPIO pin number for PN532 I2C SCL (Serial Clock Line)

    config PN532_SDA_PIN
        int "PN532 I2C SDA Pin"
        range 0 21
        help
            GPIO pin number for PN532 I2C SDA (Serial Data Line)

    config PN532_RESET_PIN
        int "PN532 Reset Pin"
        range -1 21
        help
            GPIO pin number for PN532 Reset pin (-1 to disable)

    config PN532_IRQ_PIN
        int "PN532 Interrupt Pin"
        range 0 21
        help
            GPIO pin number for PN532 Interrupt pin

    config LED_PIN
        int "LED Pin"
        range 0 52
        help
            GPIO pin number for LED (normal LED or Neopixel data pin)

    config LED_NUM
        int "Number of LEDs"
        range 1 100
        default 1
        help
            Number of LEDs in the strip (for Neopixel) or 1 for single LED

    config LED_RMT_RES_HZ
        int "LED RMT Resolution (Hz)"
        range 1000000 40000000
        default 10000000
        help
            RMT resolution frequency for Neopixel LEDs (10MHz default)

    config USE_NEOPIXEL
        bool "Use Neopixel LED"
        default n
        help
            Enable Neopixel RGB LED support. If disabled, uses normal single-color LED.

endmenu
```

## sdkconfig.defaults
```kconfig
# ESP32-C5 Configuration
CONFIG_IDF_TARGET="esp32c5"

# FreeRTOS Configuration
CONFIG_FREERTOS_HZ=1000

# Log Configuration
CONFIG_LOG_DEFAULT_LEVEL_INFO=y
CONFIG_LOG_MAXIMUM_LEVEL=5

# I2C Configuration
CONFIG_I2C_ENABLE_DEBUG_LOG=y

# Component Configuration
CONFIG_ESP_SYSTEM_EVENT_TASK_STACK_SIZE=2304
CONFIG_ESP_MAIN_TASK_STACK_SIZE=3584

# Memory Configuration
CONFIG_ESP32C5_DEFAULT_CPU_FREQ_160=y
CONFIG_ESP32C5_DEFAULT_CPU_FREQ_MHZ=160

# Partition Table
CONFIG_PARTITION_TABLE_SINGLE_APP=y




## TinyUSB HID (ESP32-S3)
# Enable HID and use default descriptors (esp_tinyusb provides device + strings)
CONFIG_TINYUSB_HID_COUNT=1

# Prefer Full-Speed (FS) and disable DMA to avoid DWC2 asserts on some boards
# Note: DMA can be re-enabled later once stable
# CONFIG_TINYUSB_MODE_DMA is not set
CONFIG_TINYUSB_RHPORT_FS=y

# TinyUSB task config
CONFIG_TINYUSB_TASK_STACK_SIZE=4096
CONFIG_TINYUSB_TASK_PRIORITY=5
CONFIG_TINYUSB_DEBUG_LEVEL=1
```
